## linux-2.6.35.4_fa93/arch/arm/mach-w55fa93/Kconfig
```kconfig
if ARCH_W55FA93

config CPU_W55FA93
	bool
	default y

menu "W55FA93 Machines"

config ARCH_W55FA93DEV
	bool "W55FA93 DEV-Nuvoton Evaluation Kit"
	select CPU_W55FA93
	help
	   Say Y here if you are using the Nuvoton Evaluation Kit W55FA93 Demo Board
           <http://www.nuvoton.com>       

choice
	prompt "External Crystal"
	default EXTCLK_12M

config EXTCLK_12M
	bool "12MHz"

config EXTCLK_27M
	bool "27MHz"

endchoice


config SET_CPU_CLOCK_BY_BOOT_CODE
       bool "CPU clock set by boot code"
       default n
       help
       Say Y here only if target system clock is configured by boot code

choice
        prompt "Kernel Load Address"
        default LD_ADDR_0
	help
           Default kernel load address for SD boot and NAND boot is 0x00000000. 
           Set to 0x00008000 only if you know what you are doing

config LD_ADDR_0
        bool "0x00000000"

config LD_ADDR_8000
        bool "0x00008000"
endchoice

endmenu
endif
```

## linux-2.6.35.4_fa93/drivers/media/jpeg/Kconfig
```kconfig
#
# HW jpeg codec configuration
#


menu "HW jpeg codec"
	depends on VIDEO_DEV

comment "Hardware jpeg codec"

source "drivers/media/jpeg/w55fa93/Kconfig"

endmenu # w55fa93 hw jpeg codec
```

## linux-2.6.35.4_fa93/drivers/media/jpeg/w55fa93/Kconfig
```kconfig
config JPEG_CODEC
	tristate "W55FA93 HW jpeg codec support"
	depends on ARCH_W55FA93 && VIDEO_DEV
	---help---
	  Say Y here if you wnat to use W55FA93's hardware jpeg codec.

config JPEG_CODEC_BUFFER_SIZE
	hex "Max Raw data size - w*h*byteperpixel(hex) + Max Bistream Size"
	default 0xC8000
	depends on ARCH_W55FA93 && VIDEO_DEV && JPEG_CODEC
	help
	  Configure for jpeg encode data buffer size.
	  default is 640*480*2 raw data buffer + 100K (Raw data buffer * 0.4) output buffer
```

## linux-2.6.35.4_fa93/drivers/media/video/w55fa93_hw/Kconfig
```kconfig
config W55FA93_VIDEOIN_DEV1
	bool "W55FA93 video capture port 1 support"
	depends on ARCH_W55FA93 && VIDEO_DEV
	---help---
	  Say Y here if you have W55FA93chip(nuvoTon).

	  To compile this driver as a module, choose M here: the
	  module will be called W55FA93_videoin_dev1.


config VIN_DEV1_ENCODE_BUF_NO
        int "VideoIn DEV1 encode buffer numbers"
		range 1 3
        default 3
        depends on W55FA93_VIDEOIN_DEV1
        help
          Specified the encode buffer numbers 

config VIN_DEV1_BUFFER_SIZE
        hex "VideoIn DEV1 buffer size"
        default 0x23B160
        depends on W55FA93_VIDEOIN_DEV1
        help
          Default is (640x480x2+4096)x3+(320x240x2+4096)x3 + (320/8x240/8+4096)x2 = 0x23B160 (Planar YUV422)

choice 
	prompt "Encode format"
        default PLANAR_YUV422_YUV420_DEV1
	depends on W55FA93_VIDEOIN_DEV1
	
		config  PLANAR_YUV422_YUV420_DEV1
			bool "Support planar yuv422/yuv420"
		config  PLANAR_YUV420_DEV1
			bool "Support planar yuv420"
endchoice

config SPECIFIED_PACKET_DIMENSION_DEV1
	tristate "Specified the packet dimension"
	depends on W55FA93_VIDEOIN_DEV1
	help
	  Specified the packet dimension. if disable, the packet dimension same as what panel dimension you choice.
	  If you don't know what to do here, say N.

config PACKET_WIDTH
	int "Packet pipe width"
	depends on SPECIFIED_PACKET_DIMENSION_DEV1
	default "320"
config PACKET_HEIGHT
	int "Packet pipe height"
	depends on SPECIFIED_PACKET_DIMENSION_DEV1
	default "240"

choice
    prompt "Video Sensor support"
		default SENSOR_OV7725_DEV1
	depends on W55FA93_VIDEOIN_DEV1
  
		config SENSOR_OV9660_DEV1
			bool "OV9660 sensor support"
		config SENSOR_OV7670_DEV1
			bool "OV7670 sensor support"
		config SENSOR_OV7725_DEV1
			bool "OV7725 sensor support"
		config SENSOR_OV7740_DEV1
			bool "OV7740 sensor support"
		config SENSOR_NT99140_DEV1
			bool "NT99140 sensor support"
		config SENSOR_NT99141_DEV1
			bool "NT99141 sensor support"
		config SENSOR_NT99050_DEV1
			bool "NT99050 sensor support"
		config SENSOR_GC0308_DEV1
			bool "GC0308 sensor support"						
		config SENSOR_OV7675_DEV1
			bool "OV7675 sensor support"	
		config SENSOR_TW9912_DEV1	
			bool "TW9912 sensor support"	
		config SENSOR_TVP5150_DEV1	
			bool "TVP5150 sensor support"
		config SENSOR_TW9900_DEV1	
			bool "TW9900 sensor support"
endchoice

choice
    prompt "Frame rate selection"
		default 30_FRAME_DEV1
	depends on SENSOR_NT99050_DEV1  
		config 30_FRAME_DEV1
			bool "30 frames/sec"
		config 60_FRAME_DEV1
			bool "60 frames/sec"
endchoice

choice
    prompt "NTSC/PAL System selection"
		default PAL_SYSTEM_DEV1
	depends on SENSOR_TW9912_DEV1 || SENSOR_TVP5150_DEV1 || SENSOR_TW9900_DEV1
		config PAL_SYSTEM_DEV1
			bool "PAL system"
		config NTSC_SYSTEM_DEV1
			bool "NTSC system"
endchoice
choice
    prompt "Resolution selection"
		default VGA_RESOLUTION
	depends on SENSOR_TW9912_DEV1 
		config VGA_RESOLUTION
			bool "VGA resolution"
		config D1_RESOLUTION
			bool "D1 resolution"
endchoice

config PAL_CROP_START_X
        int "PAL Cropping Start Poistion X"
        default 47
        depends on PAL_SYSTEM_DEV1 && SENSOR_TW9912_DEV1
        help
          Default 47 for TW9912.
config PAL_CROP_START_Y
         int "PAL Cropping Start Poistion Y"
        default 36
        depends on PAL_SYSTEM_DEV1 && SENSOR_TW9912_DEV1
        help
          Default 36 for TW9912.
config NTSC_CROP_START_X
        int "NTSC Cropping Start Poistion X"
        default 42
        depends on NTSC_SYSTEM_DEV1 && SENSOR_TW9912_DEV1
        help
          Default 42 for TW9912.
config NTSC_CROP_START_Y
         int "NTSC Cropping Start Poistion Y"
        default 37
        depends on NTSC_SYSTEM_DEV1 && SENSOR_TW9912_DEV1
        help
          Default 37 for TW9912
		
config PAL_CROP_START_X
        int "PAL Cropping Start Poistion X"
        default 2
        depends on (PAL_SYSTEM_DEV1 && SENSOR_TVP5150_DEV1)
        help
          Default 2 for TVP5150.
config PAL_CROP_START_Y
         int "PAL Cropping Start Poistion Y"
        default 2
        depends on (PAL_SYSTEM_DEV1 && SENSOR_TVP5150_DEV1)
        help
          Default 2 for TVP5150.
config NTSC_CROP_START_X
        int "NTSC Cropping Start Poistion X"
        default 2
        depends on (NTSC_SYSTEM_DEV1 && SENSOR_TVP5150_DEV1)
        help
          Default 2 for TVP5150.
config NTSC_CROP_START_Y
         int "NTSC Cropping Start Poistion Y"
        default 2
        depends on (NTSC_SYSTEM_DEV1 && SENSOR_TVP5150_DEV1)
        help
          Default 2 for TVP5150

config PAL_CROP_START_X
         int "PAL Cropping Start Poistion X"
        default 2
        depends on PAL_SYSTEM_DEV1 && SENSOR_TW9900_DEV1
        help
          Default 2 for TW9900.
config PAL_CROP_START_Y
         int "PAL Cropping Start Poistion Y"
        default 2
        depends on PAL_SYSTEM_DEV1 && SENSOR_TW9900_DEV1
        help
          Default 2 for TW9900.
config NTSC_CROP_START_X
        int "NTSC Cropping Start Poistion X"
        default 0
        depends on NTSC_SYSTEM_DEV1 && SENSOR_TW9900_DEV1
        help
          Default 0 for TW9900.
config NTSC_CROP_START_Y
         int "NTSC Cropping Start Poistion Y"
        default 0
        depends on NTSC_SYSTEM_DEV1 && SENSOR_TW9900_DEV1
        help
          Default 0 for TW9900

choice
    prompt "Fields Selection"
		default ONE_FIELD
	depends on SENSOR_TVP5150_DEV1 || SENSOR_TW9900_DEV1
		config ONE_FIELD
			bool "one filed"
		config TWO_FIELDS
			bool "two fields"
endchoice
  
choice
    prompt "Flicker Setting"
		default FLICKER_60HZ
	depends on W55FA93_VIDEOIN_DEV1
  
		config FLICKER_60HZ_DEV1
			bool "Flicker setting is 60Hz"
		config FLICKER_50HZ_DEV1
			bool "Flicker setting is 50Hz"		
endchoice


config SENSOR_POWER_DOWN
	tristate "Support sensor power down pin"
	depends on W55FA93_VIDEOIN_DEV1
	default y
	---help---
	  Say Y here if you wnat to support sensor power down pin.
choice  
	prompt "GPIO Group used for sensor power down"
  	depends on SENSOR_POWER_DOWN
  	default SENSOR_PD_GROUP_B
config SENSOR_PD_GROUP_A
	bool "Group A"
config SENSOR_PD_GROUP_B
	bool "Group B"
config SENSOR_PD_GROUP_C
	bool "Group C"
config SENSOR_PD_GROUP_D
	bool "Group D"
config SENSOR_PD_GROUP_E
	bool "Group E"
endchoice

config SENSOR_PD_PIN
	int "GPIO pin number used for sensor power down"
	depends on SENSOR_POWER_DOWN
	default "3"
config SENSOR_RESET
	tristate "Support sensor reset pin"
	depends on W55FA93_VIDEOIN_DEV1
	default y
	---help---
	  Say Y here if you wnat to support sensor reset pin.
choice  
	prompt "GPIO Group used for sensor reset"
  	depends on SENSOR_RESET
  	default SENSOR_RESET_GROUP_B
config SENSOR_RESET_GROUP_A
	bool "Group A"
config SENSOR_RESET_GROUP_B
	bool "Group B"
config SENSOR_RESET_GROUP_C
	bool "Group C"
config SENSOR_RESET_GROUP_D
	bool "Group D"
config SENSOR_RESET_GROUP_E
	bool "Group E"
endchoice

config SENSOR_RESET_PIN
	int "GPIO pin number used for sensor reset"
	depends on SENSOR_RESET
	default "2"  


choice
    prompt "Horizonal/Vertical sync pins select"
        default HV_FROM_GPE0_GPE1_DEV1
	depends on W55FA93_VIDEOIN_DEV1
		config HV_FROM_GPB2_GPB3_DEV1
			bool "Hsync/Vsync through GPB2/GPB3"
		config HV_FROM_GPE0_GPE1_DEV1
			bool "Hsync/Vsync through GPE0/GPE1"	
endchoice
```

## linux-2.6.35.4_fa93/sound/soc/w55fa93/Kconfig
```kconfig
##
## W55FA93 series SPU/I2S API
##

config SOUND_W55FA93_PLAY_DEVICE
	tristate "W55FA93 Audio Play Device"

choice
    prompt "Play device select"
        default SND_SOC_W55FA93_SPU
	depends on SOUND_W55FA93_PLAY_DEVICE

config SND_SOC_W55FA93_SPU
        bool "W55FA93 SPU Support for Playing"

config SND_SOC_W55FA93_I2S
        bool "NAU8822 I2S Audio Codec Support for Playing and Recording"
endchoice

config SND_SOC_W55FA93_I2S_ONLY
	tristate "W55FA93 Audio I2S Playing without Codec"
	depends on SND_SOC_W55FA93_I2S

choice
    prompt "SPU output select"
        default SPU_WITHOUT_I2S_OUTPUT
	depends on SND_SOC_W55FA93_SPU && !W55FA93_TV_FROM_APLL

config SPU_WITH_I2S_OUTPUT
        bool "W55FA93 SPU with I2S signal output"

config SPU_WITHOUT_I2S_OUTPUT
		bool "W55FA93 SPU without I2S signal output"
endchoice

choice
    prompt "Speaker output select"
        default NO_CONTROL_FOR_SPEAKER_ENABLED
	depends on SND_SOC_W55FA93_SPU

config GPA7_FOR_SPEAKER_ENABLED
        bool "GPA7 used for speaker control"

config NO_CONTROL_FOR_SPEAKER_ENABLED
		bool "No pin used for speaker control"
endchoice

config HEADSET_SPEAKER_CONTROL_PIN_SELECT
	tristate "Headset Detect and Speaker Control"

choice
    prompt "Headset detect Enable or Disabled ?"
        default HEADSET_DISABLED
	depends on HEADSET_SPEAKER_CONTROL_PIN_SELECT
      
config HEADSET_DISABLED
	bool "Headset detect Disabled"

config HEADSET_ENABLED
	bool "Headset detect Enabled"
endchoice	

choice
    prompt "Pins select"
        default HEADSET_GPB2_AND_SPEAKER_GPB3
	depends on HEADSET_ENABLED
      
config HEADSET_GPB2_AND_SPEAKER_GPB3
	bool "GPB2 for headset detect and GPB3 for speaker control"

config HEADSET_GPD14_AND_SPEAKER_GPA2
	bool "GPD14 for headset detect and GPA2 for speaker control"

config HEADSET_GPE0_AND_SPEAKER_GPE1
	bool "GPE0 for headset detect and GPE1 for speaker control"

config HEADSET_GPD3_AND_SPEAKER_GPD4
	bool "GPD3 for headset detect and GPD4 for speaker control"

endchoice

choice
    prompt "State select for GPD3"
        default HEADSET_GPD3_LOW
	depends on HEADSET_GPD3_AND_SPEAKER_GPD4
      
config HEADSET_GPD3_HIGH
	bool "HEADSET plug-in -> GPD3=High"

config HEADSET_GPD3_LOW
	bool "HEADSET plug-in -> GPD3=Low"

endchoice
```

## linux-2.6.35.4_fa93/sound/soc/w55fa93adc/Kconfig
```kconfig
##
## W55FA9X series ADC audio recording
##

config SND_SOC_W55FA93
	tristate "SoC Audio for W55FA93 series"
	depends on ARCH_W55FA93
	help
	  This option enables support for ADC recording mode on the W55FA93 SoC.

config SND_SOC_W55FA93_ADC
	tristate "W55FA93 ADC recording for demo board"
	depends on SND_SOC_W55FA93
	select SND_SOC_W55FA93_CODEC_ADC     
	help
	  Select this option to enable audio recording from ADC on the
	  W55FA93 demoboard.
```
